## sdkconfig.defaults
```kconfig
# Target
CONFIG_IDF_TARGET="esp32s3"

# Flash: 2MB, DIO, 80MHz
CONFIG_ESPTOOLPY_FLASHMODE_DIO=y
CONFIG_ESPTOOLPY_FLASHFREQ_80M=y
CONFIG_ESPTOOLPY_FLASHSIZE_2MB=y
CONFIG_ESPTOOLPY_FLASHSIZE="2MB"
CONFIG_ESPTOOLPY_MONITOR_BAUD=115200

# Partition table
CONFIG_PARTITION_TABLE_SINGLE_APP=y

# CPU: 160MHz
CONFIG_ESP_DEFAULT_CPU_FREQ_MHZ_160=y

# XTAL: 40MHz
CONFIG_XTAL_FREQ_40=y

# No PSRAM
# CONFIG_SPIRAM is not set

# RTC clock: internal RC
CONFIG_RTC_CLK_SRC_INT_RC=y

# Console: UART0 + secondary USB Serial JTAG
CONFIG_ESP_CONSOLE_UART_DEFAULT=y
CONFIG_ESP_CONSOLE_UART_BAUDRATE=115200
CONFIG_ESP_CONSOLE_SECONDARY_USB_SERIAL_JTAG=y

# Compiler: Debug
CONFIG_COMPILER_OPTIMIZATION_DEBUG=y

# Log level: INFO
CONFIG_LOG_DEFAULT_LEVEL_INFO=y

# Bootloader log: INFO
CONFIG_BOOTLOADER_LOG_LEVEL_INFO=y

# Watchdog
CONFIG_ESP_INT_WDT=y
CONFIG_ESP_INT_WDT_TIMEOUT_MS=300
CONFIG_ESP_TASK_WDT_EN=y
CONFIG_ESP_TASK_WDT_TIMEOUT_S=5

# Panic / Crash-Diagnose
# Panic-Handler gibt Backtrace + Register-Dump auf UART aus, dann Reboot.
# Bei TG1WDT_SYS_RST (Double Exception) erscheint der Backtrace VOR dem Reset.
CONFIG_ESP_SYSTEM_PANIC_PRINT_REBOOT=y

# Core-Dump: kein UART-Dump (erzeugt Binärmüll im Monitor).
# Crash-Info kommt ausschließlich vom Panic-Handler (Backtrace + Register).
CONFIG_ESP_COREDUMP_ENABLE=n

# Stack-Overflow-Erkennung via Canary-Bytes am Stack-Ende.
CONFIG_FREERTOS_CHECK_STACKOVERFLOW_CANARY=y

# FreeRTOS
CONFIG_FREERTOS_HZ=1000
# Für vTaskList() (LOG_STACK): Task-Laufzeitstatistiken aktivieren
CONFIG_FREERTOS_USE_STATS_FORMATTING_FUNCTIONS=y
CONFIG_FREERTOS_USE_TRACE_FACILITY=y

# SPI master ISR in IRAM – erforderlich für LVGL DMA-Flush (SPI-Transfer-Completion
# ISR muss latenzfrei laufen, sonst TG1WDT bei erstem lv_timer_handler() Call).
CONFIG_SPI_MASTER_ISR_IN_IRAM=y

# I2C master ISR in IRAM – nicht erforderlich, da VEML7700 kein zeitkritisches
# I2C-Timing benötigt. Deaktiviert um IRAM-Headroom freizugeben.
CONFIG_I2C_MASTER_ISR_HANDLER_IN_IRAM=n

# WiFi IRAM-Optimierungen – WiFi wird in diesem Projekt nicht verwendet.
# Deaktiviert um IRAM-Headroom freizugeben.
CONFIG_ESP_WIFI_IRAM_OPT=n
CONFIG_ESP_WIFI_RX_IRAM_OPT=n

# LVGL
CONFIG_LV_CONF_SKIP=y
CONFIG_LV_COLOR_DEPTH_16=y
CONFIG_LV_MEM_SIZE_KILOBYTES=64
CONFIG_LV_DEF_REFR_PERIOD=33
CONFIG_LV_DPI_DEF=130
CONFIG_LV_USE_DRAW_SW=y
CONFIG_LV_FONT_MONTSERRAT_8=y
CONFIG_LV_FONT_MONTSERRAT_14=y
CONFIG_LV_FONT_DEFAULT_MONTSERRAT_14=y
CONFIG_LV_TXT_ENC_UTF8=y
CONFIG_LV_USE_LABEL=y
CONFIG_LV_USE_ARC=y
CONFIG_LV_USE_IMG=y
CONFIG_LV_USE_THEME_DEFAULT=y
CONFIG_LV_USE_FLEX=y
CONFIG_LV_USE_GRID=y
```
